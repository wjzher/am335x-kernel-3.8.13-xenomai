## drivers/xenomai/fpga/Kconfig
```kconfig
menu "AGV FPGA driver"

config XENO_DRIVERS_FPGA
	depends on XENO_SKIN_RTDM && SOC_AM33XX
	tristate "AGV FPGA driver"
	help
	Real-time fpga driver for AM335x

endmenu
```

## drivers/xenomai/jl098b/Kconfig
```kconfig
menu "MECHATROLINK drivers"

config XENO_DRIVERS_JL098B
	depends on XENO_SKIN_RTDM && SOC_AM33XX
	tristate "MECHATROLINK JL098B driver"
	help
	Real-time JL098B driver for AM335x

endmenu
```
